// SPDX-License-Identifier: (GPL-2.0+ OR MIT)
/*
 * Copyright (c) 2024 Adakta, Ltd.
 *
 */

/dts-v1/;

#include "rk3568-adakta-smarc-base.dtsi"

/ {
	model = "Adakta SMARC Board";
	compatible = "adakta,adakta-smarc-rk3568", "rockchip,rk3568";
};
