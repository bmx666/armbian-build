// SPDX-License-Identifier: (GPL-2.0+ OR MIT)
/*
 * Copyright (c) 2024 Adakta, Ltd.
 *
 */

/ {
	/* TODO: WIP no upstream patches */
	can0: can@fea50000 {
		compatible = "rockchip,rk3568v2-canfd";
		reg = <0x0 0xfea50000 0x0 0x1000>;
		interrupts = <GIC_SPI 341 IRQ_TYPE_LEVEL_HIGH>;
		clocks = <&cru CLK_CAN0>, <&cru PCLK_CAN0>;
		clock-names = "baudclk", "apb_pclk";
		resets = <&cru SRST_CAN0>, <&cru SRST_P_CAN0>;
		reset-names = "can", "can-apb";
		pinctrl-names = "default";
		pinctrl-0 = <&can0m0_pins>;
		status = "disabled";
	};

	/* TODO: WIP no upstream patches */
	can1: can@fea60000 {
		compatible = "rockchip,rk3568v2-canfd";
		reg = <0x0 0xfea60000 0x0 0x1000>;
		interrupts = <GIC_SPI 342 IRQ_TYPE_LEVEL_HIGH>;
		clocks = <&cru CLK_CAN1>, <&cru PCLK_CAN1>;
		clock-names = "baudclk", "apb_pclk";
		resets = <&cru SRST_CAN1>, <&cru SRST_P_CAN1>;
		reset-names = "can", "can-apb";
		pinctrl-names = "default";
		pinctrl-0 = <&can1m0_pins>;
		status = "disabled";
	};

	/* TODO: WIP no upstream patches */
	can2: can@fea70000 {
		compatible = "rockchip,rk3568v2-canfd";
		reg = <0x0 0xfea70000 0x0 0x1000>;
		interrupts = <GIC_SPI 343 IRQ_TYPE_LEVEL_HIGH>;
		clocks = <&cru CLK_CAN2>, <&cru PCLK_CAN2>;
		clock-names = "baudclk", "apb_pclk";
		resets = <&cru SRST_CAN2>, <&cru SRST_P_CAN2>;
		reset-names = "can", "can-apb";
		pinctrl-names = "default";
		pinctrl-0 = <&can2m0_pins>;
		status = "disabled";
	};
};

&can0 {
	assigned-clocks = <&cru CLK_CAN0>;
	assigned-clock-rates = <200000000>;

	compatible = "rockchip,rk3568v3-canfd", "rockchip,rk3568v2-canfd";
	status = "disabled";
};

&can1 {
	assigned-clocks = <&cru CLK_CAN1>;
	assigned-clock-rates = <200000000>;

	compatible = "rockchip,rk3568v3-canfd", "rockchip,rk3568v2-canfd";
	pinctrl-names = "default";
	pinctrl-0 = <&can1m1_pins>;
	status = "okay";
};

&can2 {
	assigned-clocks = <&cru CLK_CAN2>;
	assigned-clock-rates = <200000000>;

	compatible = "rockchip,rk3568v3-canfd", "rockchip,rk3568v2-canfd";
	pinctrl-names = "default";
	pinctrl-0 = <&can2m0_pins>;
	status = "okay";
};
