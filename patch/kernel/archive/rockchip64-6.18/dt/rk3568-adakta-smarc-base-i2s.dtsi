// SPDX-License-Identifier: (GPL-2.0+ OR MIT)
/*
 * Copyright (c) 2024 Adakta, Ltd.
 *
 */

&i2s1_8ch {
	pinctrl-names = "default";
	pinctrl-0 = <&i2s1m0_sclktx
		     &i2s1m0_lrcktx
		     &i2s1m0_sdi0
		     &i2s1m0_sdo0>;
	rockchip,trcm-sync-tx-only;
	status = "okay";
};

&i2s3_2ch {
	pinctrl-names = "default";
	pinctrl-0 = <&i2s3m0_sclk
		     &i2s3m0_lrck
		     &i2s3m0_sdi
		     &i2s3m0_sdo>;
	status = "okay";
};
