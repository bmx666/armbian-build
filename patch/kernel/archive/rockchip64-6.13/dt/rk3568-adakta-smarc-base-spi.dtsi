// SPDX-License-Identifier: (GPL-2.0+ OR MIT)
/*
 * Copyright (c) 2024 Adakta, Ltd.
 *
 */

&spi0 {
	pinctrl-names = "default";
	pinctrl-0 = <&spi0m0_pins &spi0m0_cs0>;
	cs-gpios = <&gpio0 RK_PC6 GPIO_ACTIVE_LOW>;
	status = "okay";
};

&spi3 {
	pinctrl-names = "default";
	pinctrl-0 = <&spi3m1_pins &spi3m1_cs0 &spi3m1_cs1>;
	cs-gpios = <&gpio4 RK_PC6 GPIO_ACTIVE_LOW>, <&gpio4 RK_PD1 GPIO_ACTIVE_LOW>;
	status = "disabled";
};
