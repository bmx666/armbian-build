// SPDX-License-Identifier: (GPL-2.0+ OR MIT)
/*
 * Copyright (c) 2024 Adakta, Ltd.
 *
 */

&can0 {
	compatible = "rockchip,rk3568v3-canfd", "rockchip,rk3568v2-canfd";
	pinctrl-names = "default";
	pinctrl-0 = <&can0m0_pins>;
	status = "okay";
};

&can1 {
	compatible = "rockchip,rk3568v3-canfd", "rockchip,rk3568v2-canfd";
	pinctrl-names = "default";
	pinctrl-0 = <&can1m1_pins>;
	status = "okay";
};

&can2 {
	compatible = "rockchip,rk3568v3-canfd", "rockchip,rk3568v2-canfd";
	pinctrl-names = "default";
	pinctrl-0 = <&can2m0_pins>;
	status = "okay";
};
