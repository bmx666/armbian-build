// SPDX-License-Identifier: (GPL-2.0+ OR MIT)
/*
 * Copyright (c) 2024 Adakta, Ltd.
 *
 */

&pwm2 {
	pinctrl-names = "active";
	pinctrl-0 = <&pwm2m0_pins>;
	status = "okay";
};

&pwm4 {
	pinctrl-names = "active";
	pinctrl-0 = <&pwm4m0_pins>;
	status = "okay";
};

&pwm5 {
	pinctrl-names = "active";
	pinctrl-0 = <&pwm5m1_pins>;
	status = "okay";
};

&pwm6 {
	pinctrl-names = "active";
	pinctrl-0 = <&pwm6m0_pins>;
	status = "okay";
};
